## firmware/Kconfig
```kconfig
mainmenu "CANopenNode_dspic_motor"

rsource app/core/Kconfig
rsource app/driver/Kconfig
rsource third_party/FreeRTOS-Plus-CLI/Kconfig
```

## firmware/app/core/Kconfig
```kconfig
menu "Core Configuration"
    menuconfig CORE_TEST_CMD
        depends on USE_CLI
        bool "Test"

        if CORE_TEST_CMD
            config CORE_CMD_RESET
                bool "reset"
                default y
            config CORE_CMD_TASKSTAT
                bool "task_stat"
                default y
        endif # CORE_TEST_CMD
endmenu # Core Configuration
```

## firmware/app/driver/Kconfig
```kconfig
menuconfig ENABLE_DRV_SPI
    bool "SPI"
    if ENABLE_DRV_SPI
    endif # ENABLE_DRV_SPI
```

## firmware/third_party/FreeRTOS-Plus-CLI/Kconfig
```kconfig
menuconfig USE_CLI
    bool "Use CLI"
    default y

    if USE_CLI
        config CLI_TASK_PRIORITY
            int "Task Priority"
            default 1

        config CLI_TASK_STACK_SZ
            int "Task Stack Size"
            default 256

        config CLI_COMMAND_MAX_OUTPUT_SIZE
            int "Buffer size for CLI output"
            default 256

        config CLI_COMMAND_MAX_INPUT_SIZE
            int "Buffer size for CLI input"
            default 256

        config CLI_ECHO_INPUT
            bool "Echo"
            default n

    endif # USE_CLI
```
